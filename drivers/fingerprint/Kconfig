## drivers/fingerprint/Kconfig
```kconfig
#
# Fingerprint sensor drivers (portado da base 4.19 Samsung/rsuntk)
#
menuconfig SENSORS_FINGERPRINT
	tristate "Finger Print Sensor devices"
	default n
	help
	  Say Y here to enable the fingerprint sensor class support.

config FINGERPRINT_SECURE
	tristate "fingerprint sensor support"
	depends on SENSORS_FINGERPRINT
	default n
	help
	  If you say yes here you get support for Trustzone.

config SENSORS_GW3X
	tristate "generic goodix fingerprint driver"
	depends on SENSORS_FINGERPRINT
	default n
	help
	  If you say yes here you get support for Goodix's
	  fingerprint sensor GW36X.
```
