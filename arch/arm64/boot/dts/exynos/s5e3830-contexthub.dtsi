/* Samsung Exynos 850 (S5E3830) - context hub and BCM debug */

	contexthub {
		compatible = "samsung,exynos-nanohub";
		interrupts = <0x00 0x32 0x04 0x00 0x49 0x04>;
		clocks = <0x03 0x72>;
		clock-names = "chub_bus";
		reg = <0x00 0x11a00000 0x200 0x00 0x10e00000 0x40000 0x00 0x10cf0000 0x100 0x00 0x11862d00 0x10 0x00 0x10d20000 0x10 0x00 0x11800800 0x10 0x00 0x11bd0040 0x10>;
		reg-names = "mailbox\0sram\0dumpgpr\0chub_reset\0chub_baaw\0cmu_chub_qch\0vdd_sensor_en";
		baaw,names = "chub_baaw";
		baaw,sizes = <0x01>;
		baaw,values = <0x00 0x40300 0x40900 0x11900 0x80000003>;
		smc-required = "true";
		chub-dfs-gov = "disabled";
		phandle = <0x15f>;
	};

	exynos-bcmdbg {
		compatible = "samsung,exynos-bcm_dbg";
		memory-region = <0xb7>;
		pd-name = "pd-trex\0pd-aud\0pd-dpu\0pd-mfcmscl\0pd-is\0pd-hsi";
		max_define_event = <0x07>;
		bcm_cnt_nr = <0x08>;
		define_events = <0x00 0x00 0x00 0x00 0x00 0x00 0x00 0x00 0x00 0x01 0x04 0x02 0x26 0x24 0x05 0x03 0x27 0x25 0x02 0x04 0x00 0x24 0x24 0x05 0x01 0x25 0x25 0x03 0x04 0x02 0x04 0x26 0x05 0x03 0x05 0x27 0x04 0x02 0x10 0x10 0x26 0x03 0x11 0x11 0x27 0x05 0x04 0x12 0x12 0x06 0x05 0x13 0x13 0x14 0x06 0x02 0x15 0x18 0x1b 0x03 0x16 0x19 0x1c>;
		default_define_event = <0x01>;
		define_filter_id = <0x00 0x00 0x00 0x01 0x00 0x00 0x02 0x00 0x00 0x03 0x00 0x00 0x04 0x00 0x00 0x05 0x00 0x00 0x06 0x00 0x00>;
		define_filter_id_active = <0x00 0x00 0x00 0x00 0x00 0x00 0x00 0x00 0x00 0x01 0x00 0x00 0x00 0x00 0x00 0x00 0x00 0x00 0x02 0x00 0x00 0x00 0x00 0x00 0x00 0x00 0x00 0x03 0x00 0x00 0x00 0x00 0x00 0x00 0x00 0x00 0x04 0x00 0x00 0x00 0x00 0x00 0x00 0x00 0x00 0x05 0x00 0x00 0x00 0x00 0x00 0x00 0x00 0x00 0x06 0x00 0x00 0x00 0x00 0x00 0x00 0x00 0x00>;
		define_filter_other_0 = <0x00 0x00 0x00 0x00 0x01 0x00 0x00 0x00 0x02 0x00 0x00 0x00 0x03 0x00 0x00 0x00 0x04 0x00 0x00 0x00 0x05 0x00 0x00 0x00 0x06 0x00 0x00 0x00>;
		define_filter_other_1 = <0x00 0x00 0x00 0x00 0x01 0x00 0x00 0x00 0x02 0x00 0x00 0x00 0x03 0x00 0x00 0x00 0x04 0x00 0x00 0x00 0x05 0x00 0x00 0x00 0x06 0x00 0x00 0x00>;
		define_filter_other_active = <0x00 0x00 0x00 0x00 0x00 0x00 0x00 0x00 0x00 0x01 0x00 0x00 0x00 0x00 0x00 0x00 0x00 0x00 0x02 0x00 0x00 0x00 0x00 0x00 0x00 0x00 0x00 0x03 0x00 0x00 0x00 0x00 0x00 0x00 0x00 0x00 0x04 0x00 0x00 0x00 0x00 0x00 0x00 0x00 0x00 0x05 0x00 0x00 0x00 0x00 0x00 0x00 0x00 0x00 0x06 0x00 0x00 0x00 0x00 0x00 0x00 0x00 0x00>;
		define_sample_id = <0x00 0x00 0x00 0x01 0x00 0x00 0x02 0x00 0x00 0x03 0x00 0x00 0x04 0x00 0x00 0x05 0x00 0x00 0x06 0x00 0x00>;
		define_sample_id_enable = <0x00 0x00 0x00 0x00 0x00 0x00 0x00 0x00 0x00 0x01 0x00 0x00 0x01 0x00 0x00 0x00 0x01 0x00 0x02 0x00 0x00 0x01 0x00 0x00 0x00 0x01 0x00 0x03 0x00 0x00 0x01 0x01 0x00 0x00 0x01 0x01 0x04 0x00 0x00 0x01 0x01 0x00 0x00 0x01 0x01 0x05 0x00 0x00 0x01 0x00 0x00 0x00 0x01 0x00 0x06 0x00 0x00 0x00 0x00 0x00 0x00 0x00 0x00>;
		bcm_ip_nr = <0x18>;
		bcm_ip_print_nr = <0x0a>;
		initial_run_bcm_ip = <0x00 0x01 0x02 0x03 0x04 0x05 0x06 0x07 0x08 0x09 0x0a 0x0b 0x0c 0x0d 0x0e 0x0f 0x10 0x11 0x12 0x13 0x14 0x15 0x16 0x17>;
		initial_bcm_run = <0x00>;
		initial_period = <0x01>;
		initial_bcm_mode = <0x00>;
		available_stop_owner = <0x00 0x01 0x02 0x03>;
		buff_size = <0x100000>;
		glb_auto_en = <0x01>;
	};
