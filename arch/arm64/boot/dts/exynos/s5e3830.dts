/dts-v1/;

/ {
	compatible = "samsung,armv8\0samsung,exynos3830";
	dtb-hw_rev = <0x00>;
	dtb-hw_rev_end = <0xff>;
	interrupt-parent = <0x01>;
	#address-cells = <0x02>;
	#size-cells = <0x01>;

	#include "s5e3830-pinctrl.dtsi"

	#include "s5e3830-bus.dtsi"

	#include "s5e3830-memory.dtsi"

	#include "s5e3830-debug.dtsi"

	#include "s5e3830-dma-iommu.dtsi"

	#include "s5e3830-gpu-storage.dtsi"

	#include "s5e3830-cpu.dtsi"

	#include "s5e3830-display.dtsi"

	#include "s5e3830-usb.dtsi"

	#include "s5e3830-security.dtsi"

	#include "s5e3830-audio.dtsi"

	#include "s5e3830-syscon-wifi.dtsi"

	#include "s5e3830-video.dtsi"

	#include "s5e3830-camera.dtsi"

	#include "s5e3830-core.dtsi"

	#include "s5e3830-devfreq.dtsi"

	#include "s5e3830-misc.dtsi"

	#include "s5e3830-thermal.dtsi"

	#include "s5e3830-contexthub.dtsi"

	#include "s5e3830-fixups.dtsi"
};
